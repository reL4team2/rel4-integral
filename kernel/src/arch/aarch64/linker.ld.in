ENTRY(_start)

PROVIDE(KERNEL_OFFSET = 0xffffff8000000000);
PROVIDE(START_ADDR = 0xffffff8040000000);
/*PROVIDE(KERNEL_OFFSET = 0x8000000000);
PROVIDE(START_ADDR = 0x8040000000);*/

PHDRS
{
    /*
     * Explicitly set the physical address of the ELF header segment to 0x0.
     * Without this, the linker defaults paddr = vaddr = 0xffffff8000000000,
     * causing elfloader's elf_getMemoryBounds(phys=1) to compute a wrong
     * physical range and crash during DTB relocation.
     *
     * Only override the header phdr; all other sections keep their
     * auto-generated PT_LOAD segments with correct AT()-specified LMAs.
     */
    elf_headers PT_LOAD FILEHDR PHDRS AT(0x0);
}

SECTIONS
{
    . = START_ADDR;

    .boot . : AT(ADDR(.boot) - KERNEL_OFFSET)
    {
        *(.boot.text)
        *(.boot.rodata)
        *(.boot.data)
        . = ALIGN(64K);
    }
    . = ALIGN(4K);
    ki_boot_end = .;

    .text . : AT(ADDR(.text) - KERNEL_OFFSET)
    {
        /* Sit inside a large frame */
        . = ALIGN(64K);
        *(.vectors)

        /* Fastpath code */
        *(.vectors.fastpath_call)
        *(.vectors.fastpath_reply_recv)
        *(.vectors.text)

        /* Anything else that should be in the vectors page. */
        *(.vectors.*)

        /* Hopefully all that fits into 4K! */

        /* Standard kernel */
        *(.text)
        *(.text.*)
    }
    . = ALIGN(4K);

    .rodata . : AT(ADDR(.rodata) - KERNEL_OFFSET)
    {
        *(.rodata)
        *(.rodata.*)
    }
    . = ALIGN(4K);

    .data . : AT(ADDR(.data) - KERNEL_OFFSET)
    {
        *(.data)
        *(.data.*)
    }
    . = ALIGN(4K);

    .bss . (NOLOAD): AT(ADDR(.bss) - KERNEL_OFFSET)
    {
        *(.bss)
        *(COMMON) /* fallback in case '-fno-common' is not used */

        /* 4k breakpoint stack */
        _breakpoint_stack_bottom = .;
        . = . + 4K;
        _breakpoint_stack_top = .;

        /* large data such as the globals frame and global PD */
        *(.bss.*)
    }

    . = ALIGN(4K);
    ki_end = .;

    /DISCARD/ :
    {
        *(.note.gnu.build-id)
        *(.comment)
    }
}
